/*******************************************************************************
* 实验名			   :温度显示实验
* 使用的IO	     : 
* 实验效果       :1602显示温度
*	注意					 ：
*******************************************************************************/

#include<reg51.h>
#include"temp.h"

//数码管IO
#define DIG	P0
sbit LSA=P2^2;
sbit LSB=P2^3;
sbit LSC=P2^4;

unsigned char code DIG_CODE[10]={0x3f,0x06,0x5b,0x4f,0x66,0x6d,0x7d,0x07,0x7f,0x6f};
unsigned char Num=0;
unsigned int disp[8]={0x3f,0x3f,0x3f,0x3f,0x3f,0x3f,0x3f,0x3f};

void LcdDisplay(int);
void Timer0Configuration();

/*******************************************************************************
* 函数名         : main
* 函数功能		   : 主函数
* 输入           : 无
* 输出         	 : 无
*******************************************************************************/

void main()
{
    Timer0Configuration();
	while(1)
	{
		LcdDisplay(Ds18b20ReadTemp());
	}
}

/*******************************************************************************
* 函数名         : LcdDisplay()
* 函数功能		   : LCD显示读取到的温度
* 输入           : v
* 输出         	 : 无
*******************************************************************************/

void LcdDisplay(int temp) 	 //lcd显示
{
    
  	unsigned char datas[] = {0, 0, 0, 0, 0}; //定义数组
	float tp;  
	if(temp< 0)				//当温度值为负数
  	{
        disp[2] = 0x40;
		//因为读取的温度是实际温度的补码，所以减1，再取反求出原码
		temp=temp-1;
		temp=~temp;
		tp=temp;
		temp=tp*0.0625*100+0.5;	
		//留两个小数点就*100，+0.5是四舍五入，因为C语言浮点数转换为整型的时候把小数点
		//后面的数自动去掉，不管是否大于0.5，而+0.5之后大于0.5的就是进1了，小于0.5的就
		//算由�0.5，还是在小数点后面。
 
  	}
 	else
  	{	
        disp[2] = 0;		
		tp=temp;//因为数据处理有小数点所以将温度赋给一个浮点型变量
		//如果温度是正的那么，那么正数的原码就是补码它本身
		temp=tp*0.0625*100+0.5;	
		//留两个小数点就*100，+0.5是四舍五入，因为C语言浮点数转换为整型的时候把小数点
		//后面的数自动去掉，不管是否大于0.5，而+0.5之后大于0.5的就是进1了，小于0.5的就
		//算加上0.5，还是在小数点后面。
	}
    disp[0] = 0;
    disp[1] = 0;
    disp[3] = DIG_CODE[temp / 10000];
	disp[4] = DIG_CODE[temp % 10000 / 1000];
	disp[5] = DIG_CODE[temp % 1000 / 100] | 0x80;
	disp[6] = DIG_CODE[temp % 100 / 10];
	disp[7] = DIG_CODE[temp % 10];
 
}

/*******************************************************************************
* 函数名         : Timer0Configuration()
* 函数功能		   : 设置计时器
* 输入           : 无
* 输出         	 : 无
*******************************************************************************/

void Timer0Configuration()
{
	TMOD=0X02;//选择为定时器模式，工作方式2，仅用TRX打开启动。

	TH0=0X9C;	//给定时器赋初值，定时100us
	TL0=0X9C;	
	ET0=1;//打开定时器0中断允许
	EA=1;//打开总中断
	TR0=1;//打开定时器		
}

/*******************************************************************************
* 函数名         : DigDisplay() interrupt 1
* 函数功能		   : 中断数码管显示
* 输入           : 无
* 输出         	 : 无
*******************************************************************************/

void DigDisplay() interrupt 1
{
//定时器在工作方式二会自动重装初，所以不用在赋值。
//	TH0=0X9c;//给定时器赋初值，定时1ms
//	TL0=0X00;		
	DIG=0; //消隐
	switch(Num)	 //位选，选择点亮的数码管，
	{
		case(7):
			LSA=0;LSB=0;LSC=0; break;
		case(6):
			LSA=1;LSB=0;LSC=0; break;
		case(5):
			LSA=0;LSB=1;LSC=0; break;
		case(4):
			LSA=1;LSB=1;LSC=0; break;
		case(3):
			LSA=0;LSB=0;LSC=1; break;
		case(2):
			LSA=1;LSB=0;LSC=1; break;
		case(1):
			LSA=0;LSB=1;LSC=1; break;
		case(0):
			LSA=1;LSB=1;LSC=1; break;	
	}
	DIG=disp[Num]; //段选，选择显示的数字。
	Num++;
	if(Num>7)
		Num=0;
}

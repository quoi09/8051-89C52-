/*******************************************************************************
* 实 验 名		 : 左右流水灯实验
* 使用的IO	     : LED使用P2,键盘使用P3.1
* 实验效果       : 按下K1键，
* 注    意		 :
*******************************************************************************/
#include<reg51.h>
#include<intrins.h>	

#define GPIO_LED P2
sbit K1=P3^1;
void Delay10ms( );   //延时10ms

/*******************************************************************************
* 函 数 名         : main
* 函数功能		   : 主函数
* 输    入         : 无
* 输    出         : 无
*******************************************************************************/
void main(void)
{
	unsigned int i,j;
	j=0xfe; //1111_1110
	
	while(1)
	{	
		GPIO_LED=j;	 
		if(K1==0)		//检测按键K1是否按下
		{
			Delay10ms();	//消除抖动
			if(K1==0)
			{
				j=_cror_(j,1);
				while((i<50)&&(K1==0))	 //检测按键是否松开
				{
					Delay10ms();
					i++;
				}
				i=0;
			}
		}		

	}				
}
/*******************************************************************************
* 函 数 名         : Delay10ms
* 函数功能		   : 延时函数，延时10ms
* 输    入         : 无
* 输    出         : 无
*******************************************************************************/
void Delay10ms(void)   //误差 0us
{
    unsigned char a,b,c;
    for(c=1;c>0;c--)
        for(b=38;b>0;b--)
            for(a=130;a>0;a--);
}